## Config.in
```kconfig
source "$BR2_EXTERNAL_RASPI3_IMG_CLS_PATH/package/mjpg-streamer-v4l2loopback/Config.in"
source "$BR2_EXTERNAL_RASPI3_IMG_CLS_PATH/package/python-tflite-runtime/Config.in"
source "$BR2_EXTERNAL_RASPI3_IMG_CLS_PATH/package/v4l2tools/Config.in"
```

## configs/raspberrypi3_imgcls_defconfig
```kconfig
BR2_arm=y
BR2_cortex_a53=y
BR2_ARM_FPU_NEON_VFPV4=y
BR2_GLOBAL_PATCH_DIR="$(BR2_EXTERNAL_RASPI3_IMG_CLS_PATH)/patches/"
BR2_TOOLCHAIN_BUILDROOT_GLIBC=y
BR2_PACKAGE_HOST_LINUX_HEADERS_CUSTOM_5_10=y
BR2_TOOLCHAIN_BUILDROOT_CXX=y
BR2_ROOTFS_DEVICE_CREATION_DYNAMIC_EUDEV=y
BR2_TARGET_GENERIC_ROOT_PASSWD="root"
BR2_SYSTEM_DHCP="eth0"
BR2_ROOTFS_OVERLAY="$(BR2_EXTERNAL_RASPI3_IMG_CLS_PATH)/board/raspberrypi3/overlay/"
BR2_ROOTFS_POST_BUILD_SCRIPT="board/raspberrypi3/post-build.sh $(BR2_EXTERNAL_RASPI3_IMG_CLS_PATH)/board/raspberrypi3/post-build.sh"
BR2_ROOTFS_POST_IMAGE_SCRIPT="$(BR2_EXTERNAL_RASPI3_IMG_CLS_PATH)/board/raspberrypi3/post-image.sh"
BR2_LINUX_KERNEL=y
BR2_LINUX_KERNEL_CUSTOM_TARBALL=y
BR2_LINUX_KERNEL_CUSTOM_TARBALL_LOCATION="$(call github,raspberrypi,linux,581049d718caf95f5feb00607ac748d5841cf27c)/linux-581049d718caf95f5feb00607ac748d5841cf27c.tar.gz"
BR2_LINUX_KERNEL_USE_CUSTOM_CONFIG=y
BR2_LINUX_KERNEL_CUSTOM_CONFIG_FILE="$(BR2_EXTERNAL_RASPI3_IMG_CLS_PATH)/board/raspberrypi3/linux.config"
BR2_LINUX_KERNEL_DTS_SUPPORT=y
BR2_LINUX_KERNEL_INTREE_DTS_NAME="bcm2710-rpi-3-b bcm2710-rpi-3-b-plus bcm2710-rpi-cm3"
BR2_LINUX_KERNEL_NEEDS_HOST_OPENSSL=y
BR2_PACKAGE_BUSYBOX_CONFIG="$(BR2_EXTERNAL_RASPI3_IMG_CLS_PATH)/board/raspberrypi3/busybox.config"
BR2_PACKAGE_V4L2LOOPBACK=y
BR2_PACKAGE_BZIP2=y
BR2_PACKAGE_RPI_FIRMWARE=y
BR2_PACKAGE_RPI_FIRMWARE_BOOTCODE_BIN=y
BR2_PACKAGE_RPI_FIRMWARE_VARIANT_PI_X=y
BR2_PACKAGE_RPI_FIRMWARE_CONFIG_FILE="$(BR2_EXTERNAL_RASPI3_IMG_CLS_PATH)/board/raspberrypi3/config.txt"
BR2_PACKAGE_RPI_WIFI_FIRMWARE=y
BR2_PACKAGE_PYTHON3=y
BR2_PACKAGE_PYTHON_PILLOW=y
BR2_PACKAGE_PYTHON_REQUESTS=y
BR2_PACKAGE_PYTHON_SETUPTOOLS=y
BR2_PACKAGE_PYTHON_SOCKETIO=y
BR2_PACKAGE_PYTHON_WEBSOCKET_CLIENT=y
BR2_PACKAGE_GNUTLS=y
BR2_PACKAGE_OPENCV4=y
BR2_PACKAGE_OPENCV4_LIB_PYTHON=y
BR2_PACKAGE_OPENCV4_LIB_VIDEOIO=y
BR2_PACKAGE_OPENCV4_WITH_JPEG=y
BR2_PACKAGE_OPENCV4_WITH_V4L=y
BR2_PACKAGE_LIBV4L=y
BR2_PACKAGE_DROPBEAR=y
# BR2_PACKAGE_DROPBEAR_CLIENT is not set
BR2_PACKAGE_IWD=y
BR2_TARGET_ROOTFS_EXT2=y
BR2_TARGET_ROOTFS_EXT2_4=y
BR2_TARGET_ROOTFS_EXT2_SIZE="128M"
# BR2_TARGET_ROOTFS_TAR is not set
BR2_PACKAGE_HOST_DOSFSTOOLS=y
BR2_PACKAGE_HOST_GENIMAGE=y
BR2_PACKAGE_HOST_MTOOLS=y
BR2_PACKAGE_MJPG_STREAMER_V4L2LOOPBACK=y
BR2_PACKAGE_PYTHON_TFLITE_RUNTIME=y
BR2_PACKAGE_V4L2TOOLS=y
```

## package/python-tflite-runtime/Config.in
```kconfig
config BR2_PACKAGE_PYTHON_TFLITE_RUNTIME
	bool "python-tflite-runtime"
	depends on BR2_PACKAGE_PYTHON3
	select BR2_PACKAGE_PYTHON_NUMPY
	help
	  TensorFlow Lite is the official solution for running machine 
	  learning models on mobile and embedded devices.

	  https://www.tensorflow.org/lite/
```

## package/v4l2tools/Config.in
```kconfig
config BR2_PACKAGE_V4L2TOOLS
	bool "v4l2tools"
	help
	  This is simple V4L2 tools based on libv4l2cpp.
	  ONLY v4l2copy IS INCLUDED IN THIS PACKAGE.
	  
	  https://github.com/mpromonet/v4l2tools
	  https://github.com/nine-point-eight-p/v4l2tools/tree/v4l2copy-only
```
